## components/drivers/can/Kconfig
```kconfig
menuconfig RT_USING_CAN
    bool "Using CAN device drivers"
    default n
    help
        Enable this option to include the CAN device driver framework.

if RT_USING_CAN

    config RT_CAN_USING_HDR
        bool "Enable CAN hardware filter support"
        default n
        help
            If your CAN controller supports hardware filtering, and you want to
            use the framework to configure these filters, enable this option.

    config RT_CAN_USING_CANFD
        bool "Enable CAN-FD support"
        default n
        help
            Enable this to support CAN with Flexible Data-Rate. This will
            increase the size of the rt_can_msg structure.

    config RT_CANMSG_BOX_SZ
        int "Software RX message box size (in messages)"
        default 16
        help
            This sets the capacity of the software buffer (FIFO) for incoming
            CAN messages.

    config RT_CANSND_BOX_NUM
        int "Number of CAN TX mailboxes"
        default 1
        help
            Number of framework-visible hardware TX mailboxes. The unified TX
            scheduler owns these mailboxes for both blocking and non-blocking TX.

    config RT_CANSND_MSG_TIMEOUT
        int "Timeout for blocking send (in OS ticks)"
        default 100
        help
            This sets the default time a blocking caller waits for TX completion.

    config RT_CAN_TX_REQUEST_COUNT
        int "Unified CAN TX request pool size"
        default 16
        range 1 256
        help
            Number of preallocated TX request descriptors shared by blocking,
            non-blocking and ISR-originated transmissions.

    config RT_CAN_NB_TX_FIFO_SIZE
        int "Legacy non-blocking send buffer size (in bytes)"
        default 256
        help
            Kept for source/configuration compatibility while the unified TX
            request pool replaces nb_tx_rb as the correctness mechanism.

    config RT_CAN_MALLOC_NB_TX_BUFFER
        bool "Dynamically allocate the legacy non-blocking send buffer"
        depends on RT_USING_HEAP
        default n
        help
            Compatibility option retained during the refactor stack.

endif

if RT_USING_DM && RT_USING_CAN
    osource "$(SOC_DM_CAN_DIR)/Kconfig"
endif
```

## components/drivers/can/utest/Kconfig
```kconfig
if RT_USING_CAN

    config RT_UTEST_CAN_FRAMEWORK
        bool "CAN Framework Test (simulated ops)"
        default n
        help
            Register a virtual CAN controller with simulated ops and verify the
            Generic CAN lifecycle, TX admission and error paths, non-blocking TX
            terminal retirement and the RX FIFO path. No CAN controller,
            transceiver or bus is required.

endif
```
